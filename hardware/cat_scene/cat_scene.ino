#include <SPI.h>
#include <Wire.h>
#include <Adafruit_GFX.h>
#include <Adafruit_SSD1306.h>

#define SCREEN_WIDTH 128 
#define SCREEN_HEIGHT 64 

#define OLED_RESET     -1 
#define SCREEN_ADDRESS 0x3C 

Adafruit_SSD1306 display(SCREEN_WIDTH, SCREEN_HEIGHT, &Wire, OLED_RESET);

int frame = 0;

const unsigned char cat_frame1 [] PROGMEM = {
  0x00, 0x00, 0x00, 0x00, 
  0x00, 0x00, 0x00, 0x00, 
  0x00, 0x60, 0x60, 0x00, 
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  0x00, 0x00, 0x00, 0x00
};

const unsigned char cat_frame2 [] PROGMEM = {
  0x00, 0x00, 0x00, 0x00, 
  0x00, 0x00, 0x00, 0x00, 
  0x00, 0x60, 0x60, 0x00, 
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  0x00, 0x00, 0x00, 0x00
};

const unsigned char sun_bmp [] PROGMEM = {
  0x00, 0x00, 
  0x09, 0x90, 
  0x07, 0xE0, 
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  0x00, 0x00
};

const unsigned char moon_bmp [] PROGMEM = {
  0x00, 0x00, 
  0x03, 0xC0, 
  0x0F, 0xE0, 
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  0x00, 0x00
};

void setup() {
  Serial.begin(115200);

  if(!display.begin(SSD1306_SWITCHCAPVCC, SCREEN_ADDRESS)) {
    Serial.println(F("Fallo I2C"));
    for(;;); 
  }
}

void loop() {
  display.clearDisplay();

  // ====== FRANJA AMARILLA (0-15px) ======
  // Animacion del sol
  int sunX = 24 + (sin(frame * 0.05) * 15);
  display.drawBitmap(sunX, 0, sun_bmp, 16, 16, SSD1306_WHITE);
  
  // Animacion de la luna
  int moonX = 104 - (sin(frame * 0.05) * 15);
  display.drawBitmap(moonX, 0, moon_bmp, 16, 16, SSD1306_WHITE);
  
  // Linea divisoria opcional
  display.drawLine(0, 15, 127, 15, SSD1306_WHITE);

  // ====== FRANJA AZUL (16-63px) ======
  display.drawLine(0, 60, 127, 60, SSD1306_WHITE); // Suelo

  // Gatito animado
  if ((frame / 5) % 2 == 0) {
    display.drawBitmap(48, 28, cat_frame1, 32, 32, SSD1306_WHITE);
  } else {
    display.drawBitmap(48, 28, cat_frame2, 32, 32, SSD1306_WHITE);
  }

  // Flores simples pixel art
  int sway = sin(frame * 0.1) * 2;
  // Flor 1
  display.drawLine(20, 60, 20 + sway, 50, SSD1306_WHITE);
  display.fillRect(18 + sway, 46, 5, 5, SSD1306_WHITE);
  display.drawPixel(20 + sway, 48, SSD1306_BLACK); // centro
  // Flor 2
  display.drawLine(108, 60, 108 + sway, 50, SSD1306_WHITE);
  display.fillRect(106 + sway, 46, 5, 5, SSD1306_WHITE);
  display.drawPixel(108 + sway, 48, SSD1306_BLACK); // centro

  display.display();
  frame++;
  delay(50);
}
